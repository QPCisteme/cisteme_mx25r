## Kconfig
```kconfig
menuconfig CISTEME_MX25R
    bool "Enable CISTEME Custom MX25R support"
    default y
    depends on DT_HAS_CISTEME_MX25R_ENABLED
    select SPI
    help
      Custom driver for Macronix MX25R flash or others compatible NOR-Flash memory
```

## dts/bindings/cisteme,mx25r.yaml
```yaml
description: "CISTEME MX25R NOR Flash Driver"

compatible: "cisteme,mx25r"

include: [spi-device.yaml]
```
